## Platforms/Tab5/sdkconfig.defaults
```kconfig
# ESP32-P4 Target
CONFIG_IDF_TARGET="esp32p4"

# Flash Configuration
CONFIG_ESPTOOLPY_FLASHMODE_QIO=y
CONFIG_ESPTOOLPY_FLASHSIZE_16MB=y
CONFIG_PARTITION_TABLE_CUSTOM=y
CONFIG_COMPILER_OPTIMIZATION_PERF=y

# SPIRAM Configuration
CONFIG_SPIRAM=y
CONFIG_SPIRAM_SPEED_200M=y
CONFIG_SPIRAM_XIP_FROM_PSRAM=y

# Cache Configuration
CONFIG_CACHE_L2_CACHE_256KB=y
CONFIG_CACHE_L2_CACHE_LINE_128B=y

# FreeRTOS
CONFIG_FREERTOS_HZ=1000
CONFIG_FREERTOS_VTASKLIST_INCLUDE_COREID=y
CONFIG_FREERTOS_GENERATE_RUN_TIME_STATS=y

# ESP Brookesia
CONFIG_ESP_BROOKESIA_MEMORY_USE_CUSTOM=y

# ═══════════════════════════════════════════════════════════════════════════════
# LVGL Core Configuration
# ═══════════════════════════════════════════════════════════════════════════════
CONFIG_LV_COLOR_SCREEN_TRANSP=y
CONFIG_LV_MEM_CUSTOM=y
CONFIG_LV_MEMCPY_MEMSET_STD=y
CONFIG_LV_DISP_DEF_REFR_PERIOD=25

# LVGL Memory - Increased pool with expansion for stability
CONFIG_LV_MEM_SIZE_KILOBYTES=96
CONFIG_LV_MEM_POOL_EXPAND_SIZE_KILOBYTES=32

# LVGL Debugging
CONFIG_LV_USE_LOG=y
CONFIG_LV_LOG_PRINTF=y
CONFIG_LV_USE_PERF_MONITOR=y
CONFIG_LV_ATTRIBUTE_FAST_MEM_USE_IRAM=y

# ═══════════════════════════════════════════════════════════════════════════════
# LVGL Fonts - Only include sizes actually used in the UI
# ═══════════════════════════════════════════════════════════════════════════════
# Used: 12 (scale labels), 14 (primary UI), 16 (headers), 20 (titles)
CONFIG_LV_FONT_MONTSERRAT_12=y
CONFIG_LV_FONT_MONTSERRAT_14=y
CONFIG_LV_FONT_MONTSERRAT_16=y
CONFIG_LV_FONT_MONTSERRAT_20=y
CONFIG_LV_FONT_DEFAULT_MONTSERRAT_14=y
CONFIG_LV_FONT_FMT_TXT_LARGE=y
CONFIG_LV_USE_FONT_COMPRESSED=y

# ═══════════════════════════════════════════════════════════════════════════════
# LVGL Widgets - Only enable what we use
# ═══════════════════════════════════════════════════════════════════════════════
# Core widgets we use
CONFIG_LV_USE_LABEL=y
CONFIG_LV_USE_BUTTON=y
CONFIG_LV_USE_SLIDER=y
CONFIG_LV_USE_IMAGE=y
CONFIG_LV_USE_ROLLER=y
CONFIG_LV_USE_TEXTAREA=y
CONFIG_LV_USE_DROPDOWN=y
CONFIG_LV_USE_BAR=y
CONFIG_LV_USE_ARC=y
CONFIG_LV_USE_LINE=y
CONFIG_LV_USE_CHECKBOX=y
CONFIG_LV_USE_BUTTONMATRIX=y
CONFIG_LV_USE_IMAGEBUTTON=y
CONFIG_LV_USE_SCALE=y
CONFIG_LV_USE_ANIMIMG=y

# Layouts
CONFIG_LV_USE_FLEX=y
CONFIG_LV_USE_GRID=y

# Theme
CONFIG_LV_USE_THEME_DEFAULT=y
CONFIG_LV_USE_THEME_SIMPLE=y

# Misc
CONFIG_LV_USE_OBSERVER=y

# Experimental features
CONFIG_IDF_EXPERIMENTAL_FEATURES=y
```
